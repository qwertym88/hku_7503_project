## firmware/chassis/main/Kconfig.projbuild
```kconfig
menu "Project chassis"
    config CHASSIS_ROS_DOMAIN_ID
        int "ROS domain ID (must match the Pi)"
        default 42
        range 0 101
    config CHASSIS_SERIAL_BAUD
        int "micro-ROS UART0 baud rate"
        default 921600
endmenu

menu "Chassis lifter (180-degree position servo)"
    config CHASSIS_LIFTER_ENABLE
        bool "Enable positional lifter (PWM starts on first /lifter command)"
        default y
    config CHASSIS_LIFTER_PORT
        int "Servo port (1=S1/GPIO8, 2=S2/GPIO21)"
        default 1
        range 1 2
    config CHASSIS_LIFTER_LOWER_DEG
        int "Lower position angle, degrees"
        default 0
        range 0 179
    config CHASSIS_LIFTER_UPPER_DEG
        int "Upper position angle, degrees (must exceed lower angle)"
        default 80
        range 1 180
    config CHASSIS_LIFTER_PULSE_0_DEG_US
        int "Calibrated pulse at 0 degrees, microseconds"
        default 500
        range 400 2600
        help
            Verify the physical endpoint without load. Endpoint pulses interpolate
            linearly; defaults 500/2500 give 1500us at 90 degrees. Swap endpoint
            pulses if the physical angle direction is reversed.
    config CHASSIS_LIFTER_PULSE_180_DEG_US
        int "Calibrated pulse at 180 degrees, microseconds"
        default 2500
        range 400 2600
    config CHASSIS_LIFTER_UP_MS
        int "Raise settling wait, milliseconds (does not set angle or speed)"
        default 600
        range 1 29999
    config CHASSIS_LIFTER_DOWN_MS
        int "Lower settling wait, milliseconds (does not set angle or speed)"
        default 600
        range 1 29999
    config CHASSIS_LIFTER_TIMEOUT_MS
        int "Task deadline timeout, milliseconds (must exceed settling waits)"
        default 5000
        range 251 30000
endmenu
```

## firmware/motor_test/main/Kconfig.projbuild
```kconfig
menu "Project motor bench test"
    config CHASSIS_ROS_DOMAIN_ID
        int "ROS domain ID"
        default 42
        range 0 101
    config CHASSIS_SERIAL_BAUD
        int "micro-ROS UART0 baud rate"
        default 921600
endmenu
```

## firmware/servo_zero/main/Kconfig.projbuild
```kconfig
menu "Continuous servo neutral calibration"
    config SERVO_ZERO_PORT
        int "Servo connector (1=S1/GPIO8, 2=S2/GPIO21)"
        default 1
        range 1 2
    config SERVO_ZERO_PULSE_US
        int "Neutral pulse width in microseconds (1500 = nominal stop)"
        default 1500
        range 1400 1600
        help
            MG996R continuous rotation: PWM commands speed and direction, not
            shaft angle. Start at 1500us, trim by 5us while unloaded until still.
            Actual stop pulse depends on the individual servo. This utility
            cannot home or hold the lift at a mechanical zero.
    config SERVO_ZERO_START_DELAY_MS
        int "Delay before servo PWM starts, milliseconds"
        default 3000
        range 0 30000
endmenu
```

## firmware/servo_zero/sdkconfig.defaults
```kconfig
CONFIG_IDF_TARGET="esp32s3"
CONFIG_FREERTOS_HZ=1000
CONFIG_ESPTOOLPY_FLASHSIZE_4MB=y
CONFIG_PARTITION_TABLE_SINGLE_APP_LARGE=y
CONFIG_LOG_DEFAULT_LEVEL_INFO=y
CONFIG_SERVO_ZERO_PORT=1
CONFIG_SERVO_ZERO_PULSE_US=1500
CONFIG_SERVO_ZERO_START_DELAY_MS=3000
```
